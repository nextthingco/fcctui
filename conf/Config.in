## conf/Config.in
```kconfig
# Emission and Immunity Testing Configuration

mainmenu "Emission/Immunity, WiFi and BT Radio Test Configuration"

choice
	prompt "Select Test Type"

config WIFI
	bool "802.11 WiFi Radio"

config BT_BREDR
	bool "Bluetooth BR/EDR Radio"

config BT_BLE
	bool "Bluetooth Low-Energy Radio"

config EMCEMI
	bool "Emission/Immunity"

endchoice

config TEST_TYPE
	string
	default "wifi" if WIFI
	default "bt" if BT_BREDR
	default "bt" if BT_BLE
	default "stress" if EMCEMI

choice
	prompt "Antenna Selection"

config ANT_UFL
	bool "u.FL connector"

config ANT_PCB
	bool "On-PCB Antenna"

endchoice

config ANT
	string
	default "ufl" if ANT_UFL
	default "pcb" if ANT_PCB

if WIFI
source conf/wifi/Config.in
endif # WIFI

if BT_BREDR || BT_BLE
source conf/bt/Config.in
endif # BT_BREDR || BT_BLE
```

## conf/bt/Config.in
```kconfig
# Bluetooth Testing Configuration

choice
	prompt "Radio TXRX Mode"

config BT_TX
	bool "Transmit"

config BT_RX
	bool "Receive"

endchoice

config BT_CHANNEL
	int
	prompt "Channel"
	default 0
	range 0 39 if BT_BLE
	range 0 78 if BT_BREDR
	help
		Channel Number


comment "Bluetooth (BREDR) Transmitter Properties"
	depends on BT_BREDR && BT_TX

comment "Bluetooth (BLE) Transmitter Properties"
	depends on BT_BLE && BT_TX

choice
	prompt "Modulation / Rate"
	depends on BT_TX && BT_BREDR
	help
		Select modulation / rates from:
			BREDR: DH1, DH3, DH5, 2DH1, 2DH3, 2DH5, 3DH1, 3DH3, 3DH5
			BLE: LE

config BT_BREDR_DH1
	bool "DH1"

config BT_BREDR_DH3
	bool "DH3"

config BT_BREDR_DH5
	bool "DH5"

config BT_BREDR_2DH1
	bool "2DH1"

config BT_BREDR_2DH3
	bool "2DH3"

config BT_BREDR_2DH5
	bool "2DH5"

config BT_BREDR_3DH1
	bool "3DH1"

config BT_BREDR_3DH3
	bool "3DH3"

config BT_BREDR_3DH5
	bool "3DH5"

endchoice

config BT_RATE
	int
	depends on BT_TX
	range 0 9
	default "0" if BT_BREDR_DH1
	default "1" if BT_BREDR_DH3
	default "2" if BT_BREDR_DH5
	default "3" if BT_BREDR_2DH1
	default "4" if BT_BREDR_2DH3
	default "5" if BT_BREDR_2DH5
	default "6" if BT_BREDR_3DH1
	default "7" if BT_BREDR_3DH3
	default "8" if BT_BREDR_3DH5
	default "9" if BT_BLE

choice
	depends on BT_TX && BT_BREDR
	prompt "Transmit Mode"

config BT_TX_CONTINUOUS
	bool "Continuous Transmit"

config BT_TX_PACKETS
	bool "Packet Transmit"

config BT_TX_DWELL
	bool "Dwell Time via Single Channel Hopping"

config BT_TX_HOP
	bool "Channel Hopping Pattern"

endchoice

config BT_TX_PACKET_COUNT
	int "Number of Transmitted Packets"
	depends on BT_TX_PACKETS
	default 0
	range 0 4000
```

## conf/wifi/Config.in
```kconfig
# WiFi Testing Configuration

config WIFI_CHANNEL
	int "Channel"
	default 1
	range 0 14
	help
		Channel number (1-14)

choice
	prompt "Radio TXRX Mode"

config WIFI_TX
	bool "Transmit"

config WIFI_RX
	bool "Receive"

endchoice

choice
	prompt "Channel Bandwidth"

config WIFI_BW_20MHZ
	bool "20 MHz"

config WIFI_BW_40MHZ
	bool "40 MHz"

endchoice

config WIFI_BW
	string
	default "0" if WIFI_BW_20MHZ
	default "1" if WIFI_BW_40MHZ

comment "WiFi (802.11) Transmitter Properties"
	depends on WIFI_TX

choice
	prompt "Guard Interval"
	depends on WIFI_TX

config WIFI_GI_LONG
	bool "Long"

config WIFI_GI_SHORT
	bool "Short"

endchoice

config WIFI_GI
	string
	depends on WIFI_TX
	default "0" if WIFI_GI_LONG
	default "1" if WIFI_GI_SHORT

config WIFI_RATE
	string "Modulation / Rate"
	depends on WIFI_TX
	default "HTMCS7"
	help
		Select modulations / rates from:
			802.11b: 1M 2M 5.5M 11M
			802.11g: 6M 9M 12M 18M 24M 36M 48M 54M
			802.11n: HTMCS0 HTMCS1 HTMCS2 HTMCS3 HTMCS4 HTMCS5 HTMCS6 HTMCS7

choice
	prompt "Transmit Mode"
	depends on WIFI_TX

config WIFI_TX_CONTINUOUS
	bool "Continuous Transmit"

config WIFI_TX_PACKETS
	bool "Packet Transmit"

config WIFI_TX_CS
	bool "Carrier Suppression Transmit"

config WIFI_TX_TONE
	bool "Single Tone Transmit"

config WIFI_TX_CARRIER
	bool "Single Carrier Transmit"

endchoice

config WIFI_TXMODE
	string
	depends on WIFI_TX
	default "background" if WIFI_TX_CONTINUOUS
	default "background,pkt" if WIFI_TX_PACKETS
	default "background,cs" if WIFI_TX_CS
	default "background,stone" if WIFI_TX_TONE
	default "background,sc" if WIFI_TX_CARRIER

comment "WiFi Transmit Packet Settings"
	depends on WIFI_TX_PACKETS

config WIFI_TX_PACKET_COUNT
	int "Number of Transmitted Packets"
	depends on WIFI_TX_PACKETS
	default 0
	range 0 100000
	help
		Set number of packets to be transmitted
		0 is continuous packet transmission
		> 0 transmit stops after stated number of packets
		unless packet interval specified in WIFI_TX_PACKET_INTERVAL

config WIFI_TX_PACKET_LENGTH
	int "Number of bytes per Packet"
	depends on WIFI_TX_PACKETS && WIFI_TX_PACKET_COUNT != 0
	default 100
	range 0 1400
	help
		Set number of bytes per transmitted packet

config WIFI_TX_PACKET_INTERVAL
	int "Interval in micro-seconds"
	depends on WIFI_TX_PACKETS && WIFI_TX_PACKET_COUNT != 0
	default 0
	range 0 1000
	help
		Set interval for packet bursts
		0 is single packet burst
		> 0 is delay between bursts in micro-seconds
```
